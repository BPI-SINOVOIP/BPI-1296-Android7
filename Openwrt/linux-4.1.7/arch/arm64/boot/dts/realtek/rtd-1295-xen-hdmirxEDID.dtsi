/*
 * rtd-1295-xen-hdmirxEDID.dtsi - HDMI Rx EDID table for REALTEK 1295 SoC
 */

/ {
	passthrough {
	    hdmirx@98034000 {

    	    Realtek,edid-table = <
			0x00 0xFF 0xFF 0xFF 0xFF 0xFF 0xFF 0x00 0x4A 0x8B 0x95 0x12 0x00 0x00 0x00 0x00
			0xFF 0x18 0x01 0x03 0x80 0x46 0x27 0x78 0x8A 0x1E 0xC5 0xAE 0x4F 0x34 0xB1 0x26
			0x0E 0x50 0x54 0xA5 0x4B 0x00 0x81 0x80 0xA9 0x40 0xD1 0xC0 0x71 0x4F 0x01 0x01
			0x01 0x01 0x01 0x01 0x01 0x01 0x01 0x1D 0x00 0x72 0x51 0xD0 0x1E 0x20 0x6E 0x28
			0x55 0x00 0xB9 0x88 0x21 0x00 0x00 0x1E 0x9A 0x29 0xA0 0xD0 0x51 0x84 0x22 0x30
			0x50 0x98 0x36 0x00 0xB9 0x88 0x21 0x00 0x00 0x1C 0x00 0x00 0x00 0xFC 0x00 0x52
			0x65 0x61 0x6C 0x74 0x65 0x6B 0x20 0x54 0x56 0x0A 0x20 0x20 0x00 0x00 0x00 0xFD
			0x00 0x32 0x4C 0x18 0x51 0x11 0x00 0x0A 0x20 0x20 0x20 0x20 0x20 0x20 0x01 0xC8
			0x02 0x03 0x3B 0xF1 0x47 0x5D 0x5F 0x90 0x20 0x05 0x04 0x02 0x2C 0x09 0x07 0x07
			0x11 0x07 0x50 0x39 0x07 0x50 0x31 0x07 0x50 0x6D 0x03 0x0C 0x00 0x10 0x00 0x80
			0x3C 0x20 0x00 0x60 0x03 0x02 0x01 0x83 0x01 0x00 0x00 0xE3 0x05 0x03 0x00 0x67
			0xD8 0x5D 0xC4 0x01 0x3C 0x80 0x00 0xE3 0x0E 0x60 0x61 0x01 0x1D 0x80 0x18 0x71
			0x1C 0x16 0x20 0x58 0x2C 0x25 0x00 0xBA 0x88 0x21 0x00 0x00 0x9E 0x00 0x00 0x00
			0x00 0x00 0x00 0x00 0x00 0x00 0x00 0x00 0x00 0x00 0x00 0x00 0x00 0x00 0x00 0x00
			0x00 0x00 0x00 0x00 0x00 0x00 0x00 0x00 0x00 0x00 0x00 0x00 0x00 0x00 0x00 0x00
			0x00 0x00 0x00 0x00 0x00 0x00 0x00 0x00 0x00 0x00 0x00 0x00 0x00 0x00 0x00 0x1F
    	    >;
    	};
    };
};
