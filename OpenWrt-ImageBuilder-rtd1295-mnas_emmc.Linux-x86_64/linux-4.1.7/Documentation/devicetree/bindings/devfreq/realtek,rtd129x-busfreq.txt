## OpenWrt-ImageBuilder-rtd1295-mnas_emmc.Linux-x86_64/linux-4.1.7/Documentation/devicetree/bindings/devfreq/realtek,rtd129x-busfreq.txt
```
Realtek RTD129x Bus DFS DT-bindings
===================================

Required properties :

- compatible : shall contain the following :
	"realtek,rtd129x-busfreq".

- clocks : shall contain a phandle of clk, which is used for 
	reference checking.

Optional propertise :

- enable : shall contain a integer, defalue 0. Set 1 for enable 
	bus dfs by default.

- polling-ms : shall contain a integer, default 1000. polling time 



* Sub nodes for clock configuration

Required properties :

- clocks : shall contain a phandle of DFS clock.

- rate : shall contain a array if u32, for freq table in MHz


Exmaple :

        busfreq {
                compatible = "realtek,rtd129x-busfreq";
                enable = <1>;
                polling-ms = <1000>;
                clocks = <&cc CC_PLL_BUS_H>;
                status = "okay";

                clk@0 {
                        clocks = <&cc CC_CLK_SYS>;
                        rate = <128 256>;
                };
                clk@1 {
                        clocks = <&cc CC_PLL_BUS_H>;
                        rate = <200 459>;
                };
        };
	
```

## OpenWrt-ImageBuilder-rtd1295-mnas_emmc.Linux-x86_64/linux-4.1.7/Documentation/devicetree/bindings/soc/realtek/spif.txt
```
Realtek Sustained Performance Interface
=======================================

Required properties :

- compatible : shall contain the following :
	"realtek,cpu-spif".

Example :

	spif {
		compatible = "realtek,spif";
		status = "okay";
	};
```

## OpenWrt-ImageBuilder-rtd1295-mnas_emmc.Linux-x86_64/linux-4.1.7/Documentation/devicetree/bindings/sound/realtek,audio-notifier.txt
```
Realtek Audio Notifier DT-bindings
----------------------------------

1 Common Properties

Required properties:

- compatible : shall contain one of the followings:
	"alc5279",
	"wm8782",
	"realtek,audio-in", for Audio-In devices, and

	"realtek,audio-analog-in" for Audio-Analog-In devices, and

	"realtek,audio-out", for Audio-out devices.

1.1 AI device

Required properties:

- reg (removed)

- muxpad0 (removed)

Optional properties:

- ai,type : shall contain "i2s" for a i2s deivce;

- ai,i2s-pin-shared: an empty property, indicates the i2s device is pin-shared.

- ai,i2s-master: an empty property, indicates the i2s device is a master-device.

1.1.1 Example 1:

	wm8782 {
		compatible = wm8782";
		status = "okay";
	};

1.1.2 Example 2:

	i2s {
		compatible = "realtek,audio-in";
		status = "okay";

		ai,type = "i2s";
		ai,i2s-pin-shared;
		ai,i2s-master;
	};

1.2 AO device

Please add subnode(s) for each AO devices.

1.2.1 Properties for a Subnode

Required properties:

- compatible : shall contain one of the followings:
	"dac",
	"spdif",
	"i2s",
	"hdmi",
	"global".

Optional properties:

- channel: only works when compatible is "i2s", shall contains a unsigned int,
	2 for 2 channels,
	8 for 8 channels.

	default value is 2.

1.2.2 Example :

	aodev {
		compatible = "realtek,audio-out";
		dac {
			compatible = "dac"
			status = "okay";
		};
		spdif {
			compatible = "spdif"
			status = "okay";
		};
		i2s {
			compatible = "i2s"
			status = "okay";
		};
		hdmi {
			compatible = "hdmi"
			status = "okay";
		};
		global {
			compatible = "global"
			status = "okay";
		};
	};
```

## OpenWrt-ImageBuilder-rtd1295-mnas_emmc.Linux-x86_64/linux-4.1.7/drivers/clk/realtek/Kconfig
```kconfig
config COMMON_CLK_REALTEK
	bool "Clock driver for realtek"
	default y if ARCH_RTD129x || ARCH_RTD139x
	select RTK_MMIO 
	select RESET_CONTROLLER

config COMMON_CLK_RTD129X
	bool "Clock driver for RTD129x"
	select COMMON_CLK_REALTEK
	default y if ARCH_RTD129x

config COMMON_CLK_RTD139X
	bool "Clock driver for RTD139x"
	select COMMON_CLK_REALTEK
	default y if ARCH_RTD139x
```

## OpenWrt-ImageBuilder-rtd1295-mnas_emmc.Linux-x86_64/linux-4.1.7/drivers/media/platform/rtk_hdcprx2p2/Kconfig
```kconfig
config RTK_HDCPRX_2P2
	tristate "HDCP RX 2.2 for Realtek platform"
	select RTK_HDMIRX
	default n
	---help---
	  Say Y, if you want to enable HDCP RX 2.2 driver on Realtek platform.

config RTK_HDCPRX_2P2_TEE
	tristate "HDCP RX 2.2 TEE for Realtek platform"
	select RTK_HDCPRX_2P2
	select TEE
	default n
	---help---
	  Say Y, if you want to enable HDCP RX 2.2 TEE driver on Realtek platform.
```

## OpenWrt-ImageBuilder-rtd1295-mnas_emmc.Linux-x86_64/linux-4.1.7/drivers/pinctrl/realtek/Kconfig
```kconfig
config PINCTRL_RTD1295
	bool "RTD129x pin controller driver"
	select PINMUX
	select GENERIC_PINCONF
```

## OpenWrt-ImageBuilder-rtd1295-mnas_emmc.Linux-x86_64/linux-4.1.7/drivers/powerctrl/Kconfig
```kconfig
menu "Power Control"

config POWER_CONTROL
    bool "Power Control Support"
    default y


config POWER_CONTROL_DEBUGFS
    bool "DebugFs fpr Power Control"
    depends on POWER_CONTROL
    default y


config POWER_CONTROL_RTD129x
	bool "Power Control for RTD129x"
	depends on POWER_CONTROL
	select PM_GENERIC_DOMAINS
	default y

endmenu
```

## OpenWrt-ImageBuilder-rtd1295-mnas_emmc.Linux-x86_64/linux-4.1.7/drivers/soc/realtek/Kconfig
```kconfig
config RTD129x
	bool "Realtek SOC drivers support"
	depends on ARCH_RTD129x
	default y
	help
	  Realtek RTD129x SOC drivers support.

	  If unsure, say N.

if RTD129x
source "drivers/soc/realtek/rtd129x/Kconfig"
endif # RTD129x

config RTK_XEN_SUPPORT
	bool "Realtek XEN support"
	depends on XEN
	default n
	help
	  Realtek XEN utility support.

if RTK_XEN_SUPPORT
source "drivers/soc/realtek/xen/Kconfig"

endif
source "drivers/soc/realtek/cwmp/Kconfig"
```

## OpenWrt-ImageBuilder-rtd1295-mnas_emmc.Linux-x86_64/linux-4.1.7/drivers/soc/realtek/xen/Kconfig
```kconfig
comment "RealTek XEN support features"

menu "Realtek XEN Features"

config RTK_DOMU_DMA
	bool "Realtek XEN DomU DMA zone support"
	depends on RTK_XEN_SUPPORT
	default y
	help
	  DomU contiguous memory region support, Target
	  region should be memory reserved in dts.

config RTK_XEN_HYPERCALL
	bool "Realtek XEN hypercall interface"
	depends on RTK_XEN_SUPPORT
	default y
	help
	  Interface for RTK xen hypercall

config RTK_XEN_GPIO
	bool "Realtek XEN GPIO framework"
	depends on RTK_XEN_HYPERCALL
	default y
	help
	  Support for Per Domain GPIO framework. Each Dom
	  controls the GPIO that is assigned.

config RTK_XEN_DOMU_RSVMEM
	bool "Realtek XEN reserve memory expose to DomU"
	depends on RTK_XEN_SUPPORT
	default n
	help
	  Support DomU Address starts from reserve memory,
	  so kernel could take control over memory system.

config RTK_XEN_DOMU_DMA_ADDR
	hex "Start PHYS ADDR of DMA memory allocated"
	depends on RTK_XEN_DOMU_RSVMEM
	default 0x30000000
	help
	  The real DMA ADDR allocated on DOMU, be sure this
	  value is set correctly since this is used on calculate
	  kernel offset.

config RTK_XEN_DOMU_KERNEL_OFFSET
	hex "Kernel location when reserved memory is used"
	depends on RTK_XEN_DOMU_RSVMEM
	default 0x47000000
	help
	  Kernel location when reserved memory is used, be
	  sure that this location starts from the last 32 MB
	  of the IPA address space DomU used. We fix the
	  the address at the end so Kernel Modules could fall
	  into +/- 128MB to fit the ko relocation constraint.

endmenu #RTD1295 Device Drivers
```

## OpenWrt-ImageBuilder-rtd1295-mnas_emmc.Linux-x86_64/linux-4.1.7/drivers/thermal/realtek/Kconfig
```kconfig
config RTK_THERMAL
    tristate "Realtek thermal management"
    depends on OF
    default y

config RTK_THERMAL_CPU_CORE_COOLING
    tristate "Realtek cpu_core cooling"
    depends on RTK_THERMAL && HOTPLUG_CPU 
    default y

config RTK_THERMAL_EOH
	tristate "Realtek thermal EOH"
	depends on RTK_THERMAL
	default y
```

## OpenWrt-ImageBuilder-rtd1295-mnas_emmc.Linux-x86_64/package/kernel/mac80211/rtkwifiu/Kconfig.rtkwifi
```kconfig
config RTKWIFIU
	tristate "Realtek USB Wireless Cards"
	depends on m
	depends on CFG80211

if RTKWIFIU

source "drivers/net/wireless/realtek/rtkwifiu/rtl8188eu/Kconfig"
source "drivers/net/wireless/realtek/rtkwifiu/rtl8188fu/Kconfig"
source "drivers/net/wireless/realtek/rtkwifiu/rtl8189es/Kconfig"
source "drivers/net/wireless/realtek/rtkwifiu/rtl8189fs/Kconfig"
source "drivers/net/wireless/realtek/rtkwifiu/rtl8192cu/Kconfig"
source "drivers/net/wireless/realtek/rtkwifiu/rtl8192ee/Kconfig"
source "drivers/net/wireless/realtek/rtkwifiu/rtl8192eu/Kconfig"
source "drivers/net/wireless/realtek/rtkwifiu/rtl8723bs/Kconfig"
source "drivers/net/wireless/realtek/rtkwifiu/rtl8723bu/Kconfig"
source "drivers/net/wireless/realtek/rtkwifiu/rtl8723du/Kconfig"
source "drivers/net/wireless/realtek/rtkwifiu/rtl8811au/Kconfig"
source "drivers/net/wireless/realtek/rtkwifiu/rtl8812ae/Kconfig"
source "drivers/net/wireless/realtek/rtkwifiu/rtl8812au/Kconfig"
source "drivers/net/wireless/realtek/rtkwifiu/rtl8814au/Kconfig"
source "drivers/net/wireless/realtek/rtkwifiu/rtl8821as/Kconfig"
source "drivers/net/wireless/realtek/rtkwifiu/rtl8821cs/Kconfig"
source "drivers/net/wireless/realtek/rtkwifiu/rtl8821au/Kconfig"
source "drivers/net/wireless/realtek/rtkwifiu/rtl8821cu/Kconfig"
source "drivers/net/wireless/realtek/rtkwifiu/rtl8822be/Kconfig"
source "drivers/net/wireless/realtek/rtkwifiu/rtl8822bu/Kconfig"
source "drivers/net/wireless/realtek/rtkwifiu/rtl8822bs/Kconfig"

endif
```
