## Openwrt/router_defconfig
```kconfig
CONFIG_TARGET_rtd1295=y
CONFIG_TARGET_rtd1295_mnas_emmc=y
CONFIG_TARGET_rtd1295_mnas_emmc_bananapi-2GB=y
CONFIG_DEVEL=y
CONFIG_TOOLCHAINOPTS=y
CONFIG_BUSYBOX_CUSTOM=y
CONFIG_ANDROID_CONSOLE=y
CONFIG_ARIA2_BITTORRENT=y
CONFIG_ARIA2_METALINK=y
CONFIG_ARIA2_OPENSSL=y
# CONFIG_AUDIO_ADDR_LEGACY is not set
CONFIG_AUDIO_ADDR_NEW=y
# CONFIG_BUSYBOX_CONFIG_ASH_BUILTIN_ECHO is not set
# CONFIG_BUSYBOX_CONFIG_BASENAME is not set
# CONFIG_BUSYBOX_CONFIG_CAT is not set
# CONFIG_BUSYBOX_CONFIG_CHGRP is not set
# CONFIG_BUSYBOX_CONFIG_CHMOD is not set
# CONFIG_BUSYBOX_CONFIG_CHOWN is not set
# CONFIG_BUSYBOX_CONFIG_CHROOT is not set
# CONFIG_BUSYBOX_CONFIG_CP is not set
# CONFIG_BUSYBOX_CONFIG_CUT is not set
# CONFIG_BUSYBOX_CONFIG_DD is not set
# CONFIG_BUSYBOX_CONFIG_DF is not set
# CONFIG_BUSYBOX_CONFIG_DIRNAME is not set
# CONFIG_BUSYBOX_CONFIG_DU is not set
# CONFIG_BUSYBOX_CONFIG_ENV is not set
# CONFIG_BUSYBOX_CONFIG_EXPR is not set
# CONFIG_BUSYBOX_CONFIG_FALSE is not set
CONFIG_BUSYBOX_CONFIG_FEATURE_BASH_IS_ASH=y
# CONFIG_BUSYBOX_CONFIG_FEATURE_BASH_IS_NONE is not set
CONFIG_BUSYBOX_CONFIG_FEATURE_DATE_COMPAT=y
CONFIG_BUSYBOX_CONFIG_FEATURE_DATE_NANO=y
CONFIG_BUSYBOX_CONFIG_FEATURE_IP_LINK=y
# CONFIG_BUSYBOX_CONFIG_FEATURE_TEST_64 is not set
CONFIG_BUSYBOX_CONFIG_FEATURE_USE_SENDFILE=y
# CONFIG_BUSYBOX_CONFIG_FREE is not set
# CONFIG_BUSYBOX_CONFIG_HEAD is not set
# CONFIG_BUSYBOX_CONFIG_HOSTID is not set
# CONFIG_BUSYBOX_CONFIG_ID is not set
CONFIG_BUSYBOX_CONFIG_IFENSLAVE=y
CONFIG_BUSYBOX_CONFIG_IP=y
# CONFIG_BUSYBOX_CONFIG_LN is not set
# CONFIG_BUSYBOX_CONFIG_MD5SUM is not set
# CONFIG_BUSYBOX_CONFIG_MKDIR is not set
# CONFIG_BUSYBOX_CONFIG_MKFIFO is not set
# CONFIG_BUSYBOX_CONFIG_MKNOD is not set
# CONFIG_BUSYBOX_CONFIG_MV is not set
# CONFIG_BUSYBOX_CONFIG_NICE is not set
# CONFIG_BUSYBOX_CONFIG_PGREP is not set
# CONFIG_BUSYBOX_CONFIG_PRINTF is not set
# CONFIG_BUSYBOX_CONFIG_PS is not set
# CONFIG_BUSYBOX_CONFIG_PWD is not set
# CONFIG_BUSYBOX_CONFIG_READLINK is not set
# CONFIG_BUSYBOX_CONFIG_RM is not set
# CONFIG_BUSYBOX_CONFIG_RMDIR is not set
# CONFIG_BUSYBOX_CONFIG_SEQ is not set
# CONFIG_BUSYBOX_CONFIG_SORT is not set
# CONFIG_BUSYBOX_CONFIG_SYNC is not set
# CONFIG_BUSYBOX_CONFIG_TAIL is not set
# CONFIG_BUSYBOX_CONFIG_TEE is not set
# CONFIG_BUSYBOX_CONFIG_TEST is not set
# CONFIG_BUSYBOX_CONFIG_TOP is not set
# CONFIG_BUSYBOX_CONFIG_TOUCH is not set
# CONFIG_BUSYBOX_CONFIG_TR is not set
# CONFIG_BUSYBOX_CONFIG_TRUE is not set
# CONFIG_BUSYBOX_CONFIG_UNAME is not set
# CONFIG_BUSYBOX_CONFIG_UNIQ is not set
# CONFIG_BUSYBOX_CONFIG_WC is not set
# CONFIG_BUSYBOX_CONFIG_YES is not set
CONFIG_CCACHE=y
CONFIG_DRIVER_11N_SUPPORT=y
CONFIG_EASYCWMP_SCRIPTS_FULL=y
CONFIG_EGLIBC_OPTION_EGLIBC_NIS=y
CONFIG_EGLIBC_OPTION_EGLIBC_SUNRPC=y
# CONFIG_FEED_luci is not set
# CONFIG_FEED_management is not set
# CONFIG_FEED_oldpackages is not set
# CONFIG_FEED_packages is not set
# CONFIG_FEED_realtek is not set
# CONFIG_FEED_routing is not set
# CONFIG_FEED_telephony is not set
# CONFIG_GCC_USE_VERSION_4_8_LINARO is not set
CONFIG_GCC_USE_VERSION_4_9_LINARO=y
CONFIG_GCC_VERSION="4.9-linaro"
CONFIG_GCC_VERSION_4_9=y
CONFIG_GCC_VERSION_4_9_LINARO=y
CONFIG_GNUTLS_ALPN=y
CONFIG_GNUTLS_ANON=y
CONFIG_GNUTLS_DTLS_SRTP=y
CONFIG_GNUTLS_HEARTBEAT=y
CONFIG_GNUTLS_OCSP=y
CONFIG_GNUTLS_PSK=y
CONFIG_KERNEL_AIO=y
CONFIG_KERNEL_ARM_PMU=y
CONFIG_KERNEL_BLK_CGROUP=y
CONFIG_KERNEL_BLK_DEV_BSG=y
CONFIG_KERNEL_CFS_BANDWIDTH=y
CONFIG_KERNEL_CGROUPS=y
CONFIG_KERNEL_CGROUP_CPUACCT=y
CONFIG_KERNEL_CGROUP_DEVICE=y
CONFIG_KERNEL_CGROUP_FREEZER=y
CONFIG_KERNEL_CGROUP_NET_PRIO=y
CONFIG_KERNEL_CGROUP_PIDS=y
CONFIG_KERNEL_CGROUP_SCHED=y
CONFIG_KERNEL_CPUSETS=y
CONFIG_KERNEL_DEVTMPFS=y
CONFIG_KERNEL_DEVTMPFS_MOUNT=y
CONFIG_KERNEL_DIRECT_IO=y
CONFIG_KERNEL_DYNAMIC_DEBUG=y
CONFIG_KERNEL_DYNAMIC_FTRACE=y
CONFIG_KERNEL_FAIR_GROUP_SCHED=y
CONFIG_KERNEL_FHANDLE=y
CONFIG_KERNEL_FREEZER=y
CONFIG_KERNEL_FTRACE=y
CONFIG_KERNEL_FUNCTION_GRAPH_TRACER=y
CONFIG_KERNEL_FUNCTION_TRACER=y
CONFIG_KERNEL_GIT_BRANCH=""
CONFIG_KERNEL_GIT_CLONE_URI="xxx"
CONFIG_KERNEL_GIT_LOCAL_REPOSITORY=""
CONFIG_KERNEL_GIT_REVISION="HEAD"
CONFIG_KERNEL_IPC_NS=y
CONFIG_KERNEL_MEMCG=y
CONFIG_KERNEL_MEMCG_KMEM=y
CONFIG_KERNEL_MEMCG_SWAP=y
CONFIG_KERNEL_MEMCG_SWAP_ENABLED=y
CONFIG_KERNEL_MM_OWNER=y
CONFIG_KERNEL_NAMESPACES=y
CONFIG_KERNEL_NET_NS=y
CONFIG_KERNEL_PERF_EVENTS=y
CONFIG_KERNEL_PID_NS=y
CONFIG_KERNEL_PROC_PAGE_MONITOR=y
CONFIG_KERNEL_PROC_PID_CPUSET=y
CONFIG_KERNEL_PROFILING=y
CONFIG_KERNEL_RESOURCE_COUNTERS=y
CONFIG_KERNEL_RTL_MULTI_LAN_DEV=y
CONFIG_KERNEL_RT_GROUP_SCHED=y
CONFIG_KERNEL_SECCOMP=y
CONFIG_KERNEL_SECCOMP_FILTER=y
CONFIG_KERNEL_UTS_NS=y
CONFIG_LIBCURL_COOKIES=y
CONFIG_LIBCURL_FILE=y
CONFIG_LIBCURL_FTP=y
CONFIG_LIBCURL_HTTP=y
CONFIG_LIBCURL_NO_SMB="!"
CONFIG_LIBCURL_POLARSSL=y
CONFIG_LIBCURL_PROXY=y
CONFIG_LIBSODIUM_MINIMAL=y
CONFIG_OPENSSL_ENGINE_CRYPTO=y
CONFIG_OPENSSL_ENGINE_DIGEST=y
CONFIG_OPENSSL_WITH_EC=y
CONFIG_PACKAGE_MAC80211_DEBUGFS=y
CONFIG_PACKAGE_MAC80211_MESH=y
CONFIG_PACKAGE_SAMBA4_MAX_DEBUG_LEVEL=-1
CONFIG_PACKAGE_alsa-lib=y
CONFIG_PACKAGE_aria2=y
CONFIG_PACKAGE_avahi-dbus-daemon=y
CONFIG_PACKAGE_blkid=y
CONFIG_PACKAGE_block-mount=y
CONFIG_PACKAGE_blockdev=y
CONFIG_PACKAGE_btrfs-progs=y
CONFIG_PACKAGE_confuse=y
CONFIG_PACKAGE_coreutils=y
CONFIG_PACKAGE_coreutils-base64=y
CONFIG_PACKAGE_coreutils-basename=y
CONFIG_PACKAGE_coreutils-cat=y
CONFIG_PACKAGE_coreutils-chcon=y
CONFIG_PACKAGE_coreutils-chgrp=y
CONFIG_PACKAGE_coreutils-chmod=y
CONFIG_PACKAGE_coreutils-chown=y
CONFIG_PACKAGE_coreutils-chroot=y
CONFIG_PACKAGE_coreutils-cksum=y
CONFIG_PACKAGE_coreutils-comm=y
CONFIG_PACKAGE_coreutils-cp=y
CONFIG_PACKAGE_coreutils-csplit=y
CONFIG_PACKAGE_coreutils-cut=y
CONFIG_PACKAGE_coreutils-dd=y
CONFIG_PACKAGE_coreutils-df=y
CONFIG_PACKAGE_coreutils-dir=y
CONFIG_PACKAGE_coreutils-dircolors=y
CONFIG_PACKAGE_coreutils-dirname=y
CONFIG_PACKAGE_coreutils-du=y
CONFIG_PACKAGE_coreutils-echo=y
CONFIG_PACKAGE_coreutils-env=y
CONFIG_PACKAGE_coreutils-expand=y
CONFIG_PACKAGE_coreutils-expr=y
CONFIG_PACKAGE_coreutils-factor=y
CONFIG_PACKAGE_coreutils-false=y
CONFIG_PACKAGE_coreutils-fmt=y
CONFIG_PACKAGE_coreutils-fold=y
CONFIG_PACKAGE_coreutils-groups=y
CONFIG_PACKAGE_coreutils-head=y
CONFIG_PACKAGE_coreutils-hostid=y
CONFIG_PACKAGE_coreutils-id=y
CONFIG_PACKAGE_coreutils-install=y
CONFIG_PACKAGE_coreutils-join=y
CONFIG_PACKAGE_coreutils-kill=y
CONFIG_PACKAGE_coreutils-link=y
CONFIG_PACKAGE_coreutils-ln=y
CONFIG_PACKAGE_coreutils-logname=y
CONFIG_PACKAGE_coreutils-ls=y
CONFIG_PACKAGE_coreutils-md5sum=y
CONFIG_PACKAGE_coreutils-mkdir=y
CONFIG_PACKAGE_coreutils-mkfifo=y
CONFIG_PACKAGE_coreutils-mknod=y
CONFIG_PACKAGE_coreutils-mktemp=y
CONFIG_PACKAGE_coreutils-mv=y
CONFIG_PACKAGE_coreutils-nice=y
CONFIG_PACKAGE_coreutils-nl=y
CONFIG_PACKAGE_coreutils-nohup=y
CONFIG_PACKAGE_coreutils-nproc=y
CONFIG_PACKAGE_coreutils-od=y
CONFIG_PACKAGE_coreutils-paste=y
CONFIG_PACKAGE_coreutils-pathchk=y
CONFIG_PACKAGE_coreutils-pinky=y
CONFIG_PACKAGE_coreutils-pr=y
CONFIG_PACKAGE_coreutils-printenv=y
CONFIG_PACKAGE_coreutils-printf=y
CONFIG_PACKAGE_coreutils-ptx=y
CONFIG_PACKAGE_coreutils-pwd=y
CONFIG_PACKAGE_coreutils-readlink=y
CONFIG_PACKAGE_coreutils-realpath=y
CONFIG_PACKAGE_coreutils-rm=y
CONFIG_PACKAGE_coreutils-rmdir=y
CONFIG_PACKAGE_coreutils-runcon=y
CONFIG_PACKAGE_coreutils-seq=y
CONFIG_PACKAGE_coreutils-sha1sum=y
CONFIG_PACKAGE_coreutils-sha224sum=y
CONFIG_PACKAGE_coreutils-sha256sum=y
CONFIG_PACKAGE_coreutils-sha384sum=y
CONFIG_PACKAGE_coreutils-sha512sum=y
CONFIG_PACKAGE_coreutils-shred=y
CONFIG_PACKAGE_coreutils-shuf=y
CONFIG_PACKAGE_coreutils-sleep=y
CONFIG_PACKAGE_coreutils-sort=y
CONFIG_PACKAGE_coreutils-split=y
CONFIG_PACKAGE_coreutils-stat=y
CONFIG_PACKAGE_coreutils-stdbuf=y
CONFIG_PACKAGE_coreutils-stty=y
CONFIG_PACKAGE_coreutils-sum=y
CONFIG_PACKAGE_coreutils-sync=y
CONFIG_PACKAGE_coreutils-tac=y
CONFIG_PACKAGE_coreutils-tail=y
CONFIG_PACKAGE_coreutils-tee=y
CONFIG_PACKAGE_coreutils-test=y
CONFIG_PACKAGE_coreutils-timeout=y
CONFIG_PACKAGE_coreutils-touch=y
CONFIG_PACKAGE_coreutils-tr=y
CONFIG_PACKAGE_coreutils-true=y
CONFIG_PACKAGE_coreutils-truncate=y
CONFIG_PACKAGE_coreutils-tsort=y
CONFIG_PACKAGE_coreutils-tty=y
CONFIG_PACKAGE_coreutils-uname=y
CONFIG_PACKAGE_coreutils-unexpand=y
CONFIG_PACKAGE_coreutils-uniq=y
CONFIG_PACKAGE_coreutils-unlink=y
CONFIG_PACKAGE_coreutils-uptime=y
CONFIG_PACKAGE_coreutils-users=y
CONFIG_PACKAGE_coreutils-vdir=y
CONFIG_PACKAGE_coreutils-wc=y
CONFIG_PACKAGE_coreutils-who=y
CONFIG_PACKAGE_coreutils-whoami=y
CONFIG_PACKAGE_coreutils-yes=y
CONFIG_PACKAGE_curl=y
CONFIG_PACKAGE_dbus=y
CONFIG_PACKAGE_dhrystone=y
CONFIG_PACKAGE_e2fsprogs=y
CONFIG_PACKAGE_easycwmp=y
CONFIG_PACKAGE_ecryptfs-utils=y
CONFIG_PACKAGE_forked-daapd=y
CONFIG_PACKAGE_getopt=y
CONFIG_PACKAGE_gettext-tools=y
CONFIG_PACKAGE_glib2=y
CONFIG_PACKAGE_hdparm=y
CONFIG_PACKAGE_hostapd-common=y
CONFIG_PACKAGE_hostapd-utils=y
CONFIG_PACKAGE_iozone=y
CONFIG_PACKAGE_ip-full=y
CONFIG_PACKAGE_iperf=y
CONFIG_PACKAGE_iperf-mt=y
CONFIG_PACKAGE_iperf3=y
CONFIG_PACKAGE_iw=y
CONFIG_PACKAGE_kmod-ata-ahci=y
CONFIG_PACKAGE_kmod-ata-core=y
CONFIG_PACKAGE_kmod-cfg80211=y
CONFIG_PACKAGE_kmod-crypto-aead=y
CONFIG_PACKAGE_kmod-crypto-aes=y
CONFIG_PACKAGE_kmod-crypto-arc4=y
CONFIG_PACKAGE_kmod-crypto-authenc=y
CONFIG_PACKAGE_kmod-crypto-core=y
CONFIG_PACKAGE_kmod-crypto-crc32c=y
CONFIG_PACKAGE_kmod-crypto-ecb=y
CONFIG_PACKAGE_kmod-crypto-hash=y
CONFIG_PACKAGE_kmod-crypto-manager=y
CONFIG_PACKAGE_kmod-crypto-pcompress=y
CONFIG_PACKAGE_kmod-crypto-sha1=y
CONFIG_PACKAGE_kmod-cryptodev=y
CONFIG_PACKAGE_kmod-dm=y
CONFIG_PACKAGE_kmod-gre=y
CONFIG_PACKAGE_kmod-ipt-android=y
CONFIG_PACKAGE_kmod-iptunnel=y
CONFIG_PACKAGE_kmod-l2tp=y
CONFIG_PACKAGE_kmod-lib-crc32c=y
CONFIG_PACKAGE_kmod-lib-lzo=y
CONFIG_PACKAGE_kmod-lib-raid6=y
CONFIG_PACKAGE_kmod-lib-xor=y
CONFIG_PACKAGE_kmod-lib-zlib=y
CONFIG_PACKAGE_kmod-lib80211=y
CONFIG_PACKAGE_kmod-mac80211=y
CONFIG_PACKAGE_kmod-mali=m
CONFIG_PACKAGE_kmod-md-linear=y
CONFIG_PACKAGE_kmod-md-mod=y
CONFIG_PACKAGE_kmod-md-multipath=y
CONFIG_PACKAGE_kmod-md-raid0=y
CONFIG_PACKAGE_kmod-md-raid1=y
CONFIG_PACKAGE_kmod-md-raid10=y
CONFIG_PACKAGE_kmod-md-raid456=y
CONFIG_PACKAGE_kmod-mii=y
CONFIG_PACKAGE_kmod-mppe=y
CONFIG_PACKAGE_kmod-nf-builtin=y
CONFIG_PACKAGE_kmod-ottbtusb=m
CONFIG_PACKAGE_kmod-pppol2tp=y
CONFIG_PACKAGE_kmod-pptp=y
CONFIG_PACKAGE_kmod-rtd1295cma=y
CONFIG_PACKAGE_kmod-rtd1295hwnat=y
CONFIG_PACKAGE_kmod-rtksdmmc=y
CONFIG_PACKAGE_kmod-rtkwifiu=y
CONFIG_PACKAGE_kmod-rtkwifiu-rtl8188eu=y
CONFIG_PACKAGE_kmod-rtkwifiu-rtl8192ee=y
CONFIG_PACKAGE_kmod-rtkwifiu-rtl8192eu=y
CONFIG_PACKAGE_kmod-rtkwifiu-rtl8723bu=y
CONFIG_PACKAGE_kmod-rtkwifiu-rtl8812ae=y
CONFIG_PACKAGE_kmod-rtkwifiu-rtl8812au=y
CONFIG_PACKAGE_kmod-rtkwifiu-rtl8822be=y
CONFIG_PACKAGE_kmod-rtl8168=y
CONFIG_PACKAGE_kmod-scsi-core=y
CONFIG_PACKAGE_kmod-udptunnel4=y
CONFIG_PACKAGE_kmod-udptunnel6=y
CONFIG_PACKAGE_kmod-ufsd=y
CONFIG_PACKAGE_ldconfig=y
CONFIG_PACKAGE_ldd=y
CONFIG_PACKAGE_libacl=y
CONFIG_PACKAGE_libaio=y
CONFIG_PACKAGE_libantlr3c=y
CONFIG_PACKAGE_libattr=y
CONFIG_PACKAGE_libavahi-client=y
CONFIG_PACKAGE_libavahi-dbus-support=y
CONFIG_PACKAGE_libbsd=y
CONFIG_PACKAGE_libbz2=y
CONFIG_PACKAGE_libc-bin=y
CONFIG_PACKAGE_libcap=y
CONFIG_PACKAGE_libcurl=y
CONFIG_PACKAGE_libdaemon=y
CONFIG_PACKAGE_libdb47=y
CONFIG_PACKAGE_libdbus=y
CONFIG_PACKAGE_libdevmapper=y
CONFIG_PACKAGE_libecryptfs=y
CONFIG_PACKAGE_libevent2=y
CONFIG_PACKAGE_libevent2.1=y
CONFIG_PACKAGE_libevent2.1-pthreads=y
CONFIG_PACKAGE_libexif=y
CONFIG_PACKAGE_libexpat=y
CONFIG_PACKAGE_libext2fs=y
CONFIG_PACKAGE_libffi=y
CONFIG_PACKAGE_libffmpeg-full=y
CONFIG_PACKAGE_libffmpeg-mini=y
CONFIG_PACKAGE_libflac=y
CONFIG_PACKAGE_libgcrypt=y
CONFIG_PACKAGE_libgdbm=y
CONFIG_PACKAGE_libgmp=y
CONFIG_PACKAGE_libgnutls=y
CONFIG_PACKAGE_libgpg-error=y
CONFIG_PACKAGE_libiconv=y
CONFIG_PACKAGE_libid3tag=y
CONFIG_PACKAGE_libintl-full=y
CONFIG_PACKAGE_libiwinfo=y
CONFIG_PACKAGE_libiwinfo-lua=y
CONFIG_PACKAGE_libjpeg=y
CONFIG_PACKAGE_libkeyutils=y
CONFIG_PACKAGE_liblua=y
CONFIG_PACKAGE_liblzo=y
CONFIG_PACKAGE_libmicroxml=y
CONFIG_PACKAGE_libmysqlclient=y
CONFIG_PACKAGE_libncurses=y
CONFIG_PACKAGE_libnettle=y
CONFIG_PACKAGE_libogg=y
CONFIG_PACKAGE_libopenssl=y
CONFIG_PACKAGE_libplist=y
CONFIG_PACKAGE_libpolarssl=y
CONFIG_PACKAGE_libpopt=y
CONFIG_PACKAGE_libprotobuf-c=y
CONFIG_PACKAGE_libreadline=y
CONFIG_PACKAGE_librpc=y
CONFIG_PACKAGE_libsasl2=y
CONFIG_PACKAGE_libsmartcols=y
CONFIG_PACKAGE_libsodium=y
CONFIG_PACKAGE_libsqlite3=y
CONFIG_PACKAGE_libstdcpp=y
CONFIG_PACKAGE_libubus-lua=y
CONFIG_PACKAGE_libuci-lua=y
CONFIG_PACKAGE_libunistring=y
CONFIG_PACKAGE_libvorbis=y
CONFIG_PACKAGE_libxml2=y
CONFIG_PACKAGE_lsblk=y
CONFIG_PACKAGE_lsof=y
CONFIG_PACKAGE_lua=y
CONFIG_PACKAGE_luci=y
CONFIG_PACKAGE_luci-app-aria2=y
CONFIG_PACKAGE_luci-app-diskmanager=y
CONFIG_PACKAGE_luci-app-easycwmp=y
CONFIG_PACKAGE_luci-app-firewall=y
CONFIG_PACKAGE_luci-app-forked-daapd=y
CONFIG_PACKAGE_luci-app-minidlna=y
CONFIG_PACKAGE_luci-app-netatalk=y
CONFIG_PACKAGE_luci-app-samba=y
CONFIG_PACKAGE_luci-app-transmission=y
CONFIG_PACKAGE_luci-app-vsftpd=y
CONFIG_PACKAGE_luci-base=y
CONFIG_PACKAGE_luci-lib-ip=y
CONFIG_PACKAGE_luci-lib-nixio=y
CONFIG_PACKAGE_luci-mod-admin-full=y
CONFIG_PACKAGE_luci-proto-ipv6=y
CONFIG_PACKAGE_luci-proto-ppp=y
CONFIG_PACKAGE_luci-theme-bootstrap=y
CONFIG_PACKAGE_lvm2=y
CONFIG_PACKAGE_mdadm=y
CONFIG_PACKAGE_minidlna=y
CONFIG_PACKAGE_mkdosfs=y
CONFIG_PACKAGE_mount-utils=y
CONFIG_PACKAGE_mxml=y
CONFIG_PACKAGE_namespace-utils=y
CONFIG_PACKAGE_netatalk=y
CONFIG_PACKAGE_openssl-util=y
CONFIG_PACKAGE_parted=y
CONFIG_PACKAGE_ppp-mod-pppol2tp=y
CONFIG_PACKAGE_ppp-mod-pptp=y
CONFIG_PACKAGE_procps=y
CONFIG_PACKAGE_procps-free=y
CONFIG_PACKAGE_procps-pgrep=y
CONFIG_PACKAGE_procps-pkill=y
CONFIG_PACKAGE_procps-pmap=y
CONFIG_PACKAGE_procps-ps=y
CONFIG_PACKAGE_procps-pwdx=y
CONFIG_PACKAGE_procps-skill=y
CONFIG_PACKAGE_procps-slabtop=y
CONFIG_PACKAGE_procps-snice=y
CONFIG_PACKAGE_procps-tload=y
CONFIG_PACKAGE_procps-top=y
CONFIG_PACKAGE_procps-vmstat=y
CONFIG_PACKAGE_procps-w=y
CONFIG_PACKAGE_procps-watch=y
CONFIG_PACKAGE_python-base=y
CONFIG_PACKAGE_python-light=y
CONFIG_PACKAGE_resize2fs=y
CONFIG_PACKAGE_resolveip=y
CONFIG_PACKAGE_rpcd=y
CONFIG_PACKAGE_rpcd-mod-file=y
CONFIG_PACKAGE_rpcd-mod-iwinfo=y
CONFIG_PACKAGE_rpcd-mod-rpcsys=y
CONFIG_PACKAGE_samba-hotplug=y
CONFIG_PACKAGE_samba4-server=y
CONFIG_PACKAGE_sfdisk=y
CONFIG_PACKAGE_shflags=y
CONFIG_PACKAGE_sqlite3-cli=y
CONFIG_PACKAGE_strace=y
CONFIG_PACKAGE_swap-utils=y
CONFIG_PACKAGE_sysstat=y
CONFIG_PACKAGE_terminfo=y
CONFIG_PACKAGE_transmission-daemon=y
CONFIG_PACKAGE_transmission-web=y
CONFIG_PACKAGE_udev=y
CONFIG_PACKAGE_uhttpd=y
CONFIG_PACKAGE_uhttpd-mod-lua=y
CONFIG_PACKAGE_uhttpd-mod-ubus=y
CONFIG_PACKAGE_vsftpd=y
CONFIG_PACKAGE_vsftpd-tls=y
CONFIG_PACKAGE_webui-aria2=y
CONFIG_PACKAGE_wireless-tools=y
CONFIG_PACKAGE_wpa-cli=y
CONFIG_PACKAGE_wpad=y
CONFIG_PACKAGE_wsdd=y
CONFIG_PACKAGE_xl2tpd=y
CONFIG_PACKAGE_yaaw=y
CONFIG_PACKAGE_zlib=y
CONFIG_PACKAGE_zoneinfo-africa=y
CONFIG_PACKAGE_zoneinfo-asia=y
CONFIG_PACKAGE_zoneinfo-atlantic=y
CONFIG_PACKAGE_zoneinfo-australia-nz=y
CONFIG_PACKAGE_zoneinfo-core=y
CONFIG_PACKAGE_zoneinfo-europe=y
CONFIG_PACKAGE_zoneinfo-india=y
CONFIG_PACKAGE_zoneinfo-northamerica=y
CONFIG_PACKAGE_zoneinfo-pacific=y
CONFIG_PACKAGE_zoneinfo-poles=y
CONFIG_PACKAGE_zoneinfo-simple=y
CONFIG_PACKAGE_zoneinfo-southamerica=y
CONFIG_RTKWIFIU=y
# CONFIG_TARGET_ANDROID_M is not set
CONFIG_TARGET_ANDROID_N=y
CONFIG_TARGET_INITRAMFS_COMPRESSION_GZIP=y
# CONFIG_TARGET_LAYOUT_SIZE_4GB is not set
CONFIG_TARGET_LAYOUT_SIZE_8GB=y
CONFIG_TARGET_NAS_IMG_EMMC_SWAP=y
CONFIG_TARGET_ROOTFS_INITRD=y
# CONFIG_TARGET_ROOTFS_SQUASHFS is not set
CONFIG_TARGET_ROOTFS_TARGZ=y
CONFIG_UDEV_EXTRA_accelerometer=y
CONFIG_UDEV_EXTRA_ata_id=y
CONFIG_UDEV_EXTRA_cdrom_id=y
CONFIG_UDEV_EXTRA_input_id=y
CONFIG_UDEV_EXTRA_mtd_probe=y
CONFIG_UDEV_EXTRA_path_id=y
CONFIG_UDEV_EXTRA_scsi_id=y
CONFIG_UDEV_EXTRA_usb_id=y
CONFIG_UDEV_EXTRA_v4l_id=y
# CONFIG_UPDATE_AUDIO_FW is not set
CONFIG_USE_RFKILL=y
CONFIG_WPA_SUPPLICANT_INTERNAL=y
# CONFIG_KERNEL_NET_CLS_CGROUP is not set
# CONFIG_KERNEL_USER_NS is not set
# CONFIG_RTKWIFIU_CONCURRENT_MODE is not set
# CONFIG_UDEV_EXTRA_qemu is not set
# CONFIG_UDEV_EXTRA_rule_generator is not set
```
