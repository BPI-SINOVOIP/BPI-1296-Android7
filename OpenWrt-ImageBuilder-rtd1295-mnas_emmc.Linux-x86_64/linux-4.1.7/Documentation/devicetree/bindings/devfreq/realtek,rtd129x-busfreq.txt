## Openwrt/linux-4.1.7/drivers/soc/realtek/rtd129x/Kconfig
```kconfig
comment "RTD129x Device Drivers"

menu "RTD129x Device Drivers"

config RTK_SB2_MEM_TRASH_MONITOR
	bool "Memory trash monitor"
	default n
	help
	  Enable helper functions for memory trash detection. If unsure, say N.

config RTK_RBUS_BARRIER
	bool "R-bus barrier"
	depends on RTK_MEM_REMAP
	default y
	help
	  Enable helper functions for R-bus barrier. If unsure, say N.

config RTK_MEM_REMAP
	bool "Memory remap"
	default y
	help
	  Enable helper functions for static ioremap. If unsure, say N.

#Add your device driver config in here.
config RTK_MCP
	bool "MCP driver"
	default n
	help
	  Realtek MCP driver

config RTK_FAN
	bool "RTK Fan driver"
	default n
	help
	  Realtek Fan driver

config RTK_ACPU_RELOAD
	bool "Dynamic ACPU reload"
	default n
	help
	  Dynamic ACPU stop/start mechanism. If unsure, say N.

config RTK_IPCSHM_RESET
	bool "Dynamic IPC share memory reset"
	depends on RTK_ACPU_RELOAD
	default n
	help
	  Reset IPC_SHM when performing dynamic ACPU stop/start.
	  If unsure, say N.

config RTK_SW_LOCK_API
	bool "RTK SW LOCK API"
	default y
	help
	  Realtek SW LOCK API driver

config RTK_VMX
	bool "VMX boot enable"
	default n
	help
	  Set VMX boot enable.

config RTK_REGMAP_I2C
	bool
	select REGMAP

config RTK_MMIO
        bool
	select REGMAP_MMIO

source "drivers/soc/realtek/rtd129x/rtk_ve/Kconfig"
source "drivers/soc/realtek/rtd129x/irda/Kconfig"
source "drivers/soc/realtek/rtd129x/rpc/Kconfig"
source "drivers/soc/realtek/rtd129x/hw_nat/Kconfig"
          
endmenu #RTD129x Device Drivers
```

## Openwrt/realtek/packages/libs/faac/Config.in
```kconfig
config FAAC_ALWAYS_USE_FLOATING_POINT
	depends on PACKAGE_libfaac
	bool "Build FAAC to use floating-point math even if using soft floats."
	default n
	help
		By default, libfaac will be built to use fixed point rather
		than floating point math if emulated floating point operations
		are being used. (See the CONFIG_SOFT_FLOAT option.) Set this
		option if you would like to use floating point math regardless
		of whether floating point emulation is in use.
		
		For the best real-time decoding ability, leave this option off.
```

## Openwrt/realtek/packages/multimedia/gst1-libav/Config.in
```kconfig
menu "Select GStreamer libav configuration options"
	depends on PACKAGE_gst1-libav

config GST1_LIBAV_IPV6
	bool "Enable IPv6"
	default IPV6

config GST1_LIBAV_PATENTED
	bool "Include patented codecs and technologies"
	default BUILD_PATENTED

config GET_LIBAV_COMMON_AV_SUPPORT
	bool "Include support for common audio/video decoders"
	default y
	select GST1_LIBAV_DECODER_aac if GST1_LIBAV_PATENTED
	select GST1_LIBAV_DECODER_ac3 if GST1_LIBAV_PATENTED
	select GST1_LIBAV_DECODER_h264 if GST1_LIBAV_PATENTED
	select GST1_LIBAV_DECODER_atrac3 if GST1_LIBAV_PATENTED
	select GST1_LIBAV_DECODER_cook if GST1_LIBAV_PATENTED
	select GST1_LIBAV_DECODER_jpegls
	select GST1_LIBAV_DECODER_mp3 if GST1_LIBAV_PATENTED
	select GST1_LIBAV_DECODER_mpeg1video
	select GST1_LIBAV_DECODER_mpeg2video if GST1_LIBAV_PATENTED
	select GST1_LIBAV_DECODER_mpeg4 if GST1_LIBAV_PATENTED
	select GST1_LIBAV_DECODER_mpeg4aac if GST1_LIBAV_PATENTED
	select GST1_LIBAV_DECODER_mpegvideo
	select GST1_LIBAV_DECODER_pcm_s16be
	select GST1_LIBAV_DECODER_pcm_s16le
	select GST1_LIBAV_DECODER_ra_144 if GST1_LIBAV_PATENTED
	select GST1_LIBAV_DECODER_ra_288 if GST1_LIBAV_PATENTED
	select GST1_LIBAV_DECODER_ralf if GST1_LIBAV_PATENTED
	select GST1_LIBAV_DECODER_sipr if GST1_LIBAV_PATENTED
	select GST1_LIBAV_DECODER_vorbis
	select GST1_LIBAV_DECODER_wmalossless if GST1_LIBAV_PATENTED
	select GST1_LIBAV_DECODER_wmapro if GST1_LIBAV_PATENTED
	select GST1_LIBAV_DECODER_wmav1 if GST1_LIBAV_PATENTED
	select GST1_LIBAV_DECODER_wmav2 if GST1_LIBAV_PATENTED
	select GST1_LIBAV_DECODER_wmavoice if GST1_LIBAV_PATENTED
	select GST1_LIBAV_DECODER_png
	select GST1_LIBAV_PARSER_aac if GST1_LIBAV_PATENTED
	select GST1_LIBAV_PARSER_cook if GST1_LIBAV_PATENTED
	select GST1_LIBAV_PARSER_h264 if GST1_LIBAV_PATENTED
	select GST1_LIBAV_PARSER_mpegaudio
	select GST1_LIBAV_PARSER_mpegvideo
	select GST1_LIBAV_PARSER_mpeg4video
	select GST1_LIBAV_DEMUXER_ac3
	select GST1_LIBAV_DEMUXER_h264 if GST1_LIBAV_PATENTED
	select GST1_LIBAV_DEMUXER_mp3 if GST1_LIBAV_PATENTED
	select GST1_LIBAV_DEMUXER_mpegvideo if GST1_LIBAV_PATENTED
	select GST1_LIBAV_DEMUXER_ogg

config GET_LIBAV_OPTIONAL_AV_SUPPORT
	bool "Include support for all optional modules"
	default y
	select GST1_LIBAV_ENCODER_ac3 if GST1_LIBAV_PATENTED
	select GST1_LIBAV_ENCODER_jpegls
	select GST1_LIBAV_ENCODER_mpeg1video
	select GST1_LIBAV_ENCODER_mpeg2video if GST1_LIBAV_PATENTED
	select GST1_LIBAV_ENCODER_mpeg4 if GST1_LIBAV_PATENTED
	select GST1_LIBAV_ENCODER_pcm_s16be
	select GST1_LIBAV_ENCODER_pcm_s16le
	select GST1_LIBAV_ENCODER_png
	select GST1_LIBAV_ENCODER_vorbis
	select GST1_LIBAV_ENCODER_wmav1
	select GST1_LIBAV_ENCODER_wmav2
	select GST1_LIBAV_ENCODER_zlib
	select GST1_LIBAV_DECODER_gif
	select GST1_LIBAV_DECODER_mp2
	select GST1_LIBAV_MUXER_ac3 if GST1_LIBAV_PATENTED
	select GST1_LIBAV_MUXER_ffm
	select GST1_LIBAV_MUXER_h264 if GST1_LIBAV_PATENTED
	select GST1_LIBAV_MUXER_mp3
	select GST1_LIBAV_MUXER_mp4
	select GST1_LIBAV_MUXER_mpeg1video
	select GST1_LIBAV_MUXER_mpeg2video
	select GST1_LIBAV_MUXER_mpegts
	select GST1_LIBAV_MUXER_ogg
	select GST1_LIBAV_MUXER_oss
	select GST1_LIBAV_MUXER_rtp
	select GST1_LIBAV_DEMUXER_ffm
	select GST1_LIBAV_DEMUXER_mpegps
	select GST1_LIBAV_DEMUXER_mpegts
	select GST1_LIBAV_DEMUXER_rm
	select GST1_LIBAV_DEMUXER_rtsp
	select GST1_LIBAV_DEMUXER_sdp
	select GST1_LIBAV_PROTOCOL_file
	select GST1_LIBAV_PROTOCOL_http
	select GST1_LIBAV_PROTOCOL_pipe
	select GST1_LIBAV_PROTOCOL_rtp
	select GST1_LIBAV_PROTOCOL_tcp
	select GST1_LIBAV_PROTOCOL_udp

comment "Encoders ---"

config GST1_LIBAV_ENCODER_ac3
	bool "AC3"
	depends on GST1_LIBAV_PATENTED
	select GST1_LIBAV_PARSER_ac3

config GST1_LIBAV_ENCODER_jpegls
	bool "JPEG-LS"

config GST1_LIBAV_ENCODER_mpeg1video
	bool "MPEG-1 Video"

config GST1_LIBAV_ENCODER_mpeg2video
	bool "MPEG-2 Video"
	depends on GST1_LIBAV_PATENTED

config GST1_LIBAV_ENCODER_mpeg4
	bool "MPEG-4"
	depends on GST1_LIBAV_PATENTED

config GST1_LIBAV_ENCODER_pcm_s16be
	bool "PCM signed 16-bit big-endian"

config GST1_LIBAV_ENCODER_pcm_s16le
	bool "PCM signed 16-bit little-endian"

config GST1_LIBAV_ENCODER_png
	bool "PNG"
	select GST1_LIBAV_ENCODER_zlib

config GST1_LIBAV_ENCODER_vorbis
	bool "Vorbis"

config GST1_LIBAV_ENCODER_wmav1
	bool "WMAv1"
	depends on GST1_LIBAV_PATENTED

config GST1_LIBAV_ENCODER_wmav2
	bool "WMAv2"
	depends on GST1_LIBAV_PATENTED

config GST1_LIBAV_ENCODER_zlib
	bool "Zlib"

comment "Decoders ---"

config GST1_LIBAV_DECODER_aac
	bool "AAC (Advanced Audio Coding)"
	depends on GST1_LIBAV_PATENTED
	select GST1_LIBAV_PARSER_aac

config GST1_LIBAV_DECODER_ac3
	bool "AC3"
	depends on GST1_LIBAV_PATENTED
	select GST1_LIBAV_PARSER_ac3

config GST1_LIBAV_DECODER_atrac3
	bool "ATRAC3"
	depends on GST1_LIBAV_PATENTED

config GST1_LIBAV_DECODER_cook
	bool "Cook / Cooker / Gecko (RealAudio G2)"
	depends on GST1_LIBAV_PATENTED
	select GST1_LIBAV_PARSER_cook

config GST1_LIBAV_DECODER_gif
	bool "GIF"

config GST1_LIBAV_DECODER_h264
	bool "H.264"
	depends on GST1_LIBAV_PATENTED

config GST1_LIBAV_DECODER_jpegls
	bool "JPEG-LS"

config GST1_LIBAV_DECODER_mp2
	bool "MP2 (MPEG Audio Layer 2)"
	depends on GST1_LIBAV_PATENTED

config GST1_LIBAV_DECODER_mp3
	bool "MP3 (MPEG Audio Layer 2)"
	depends on GST1_LIBAV_PATENTED

config GST1_LIBAV_DECODER_mpegvideo
	bool "MPEG Video"

config GST1_LIBAV_DECODER_mpeg1video
	bool "MPEG-1 Video"

config GST1_LIBAV_DECODER_mpeg2video
	bool "MPEG-2 Video"
	depends on GST1_LIBAV_PATENTED

config GST1_LIBAV_DECODER_mpeg4
	bool "MPEG-4"
	depends on GST1_LIBAV_PATENTED

config GST1_LIBAV_DECODER_mpeg4aac
	bool "MPEG-4 (AAC)"
	depends on GST1_LIBAV_PATENTED

config GST1_LIBAV_DECODER_pcm_s16be
	bool "PCM signed 16-bit big-endian"

config GST1_LIBAV_DECODER_pcm_s16le
	bool "PCM signed 16-bit little-endian"

config GST1_LIBAV_DECODER_png
	bool "PNG"
	select GST1_LIBAV_DECODER_zlib

config GST1_LIBAV_DECODER_ra_144
	bool "RealAudio 1.0 (14.4K)"
	depends on GST1_LIBAV_PATENTED

config GST1_LIBAV_DECODER_ra_288
	bool "RealAudio 2.0 (28.8K)"
	depends on GST1_LIBAV_PATENTED

config GST1_LIBAV_DECODER_ralf
	bool "RealAudio Lossless"
	depends on GST1_LIBAV_PATENTED

config GST1_LIBAV_DECODER_sipr
	bool "RealAudio SIPR / ACELP.NET"
	depends on GST1_LIBAV_PATENTED

config GST1_LIBAV_DECODER_vorbis
	bool "Vorbis"

config GST1_LIBAV_DECODER_wmalossless
	bool "WMA Lossless"
	depends on GST1_LIBAV_PATENTED

config GST1_LIBAV_DECODER_wmapro
	bool "WMA 9 Pro"
	depends on GST1_LIBAV_PATENTED

config GST1_LIBAV_DECODER_wmav1
	bool "WMAv1"
	depends on GST1_LIBAV_PATENTED

config GST1_LIBAV_DECODER_wmav2
	bool "WMAv2"
	depends on GST1_LIBAV_PATENTED

config GST1_LIBAV_DECODER_wmavoice
	bool "WMA Voice"
	depends on GST1_LIBAV_PATENTED

config GST1_LIBAV_DECODER_zlib
	bool "Zlib"

comment "Muxers ---"

config GST1_LIBAV_MUXER_ac3
	bool "AC3"
	depends on GST1_LIBAV_PATENTED

config GST1_LIBAV_MUXER_ffm
	bool "FFM (ffserver live feed)"

config GST1_LIBAV_MUXER_h264
	bool "H.264"
	depends on GST1_LIBAV_PATENTED

config GST1_LIBAV_MUXER_mp3
	bool "MP3 (MPEG Audio Layer 3)"

config GST1_LIBAV_MUXER_mp4
	bool "MP4"

config GST1_LIBAV_MUXER_mpeg1video
	bool "MPEG-1 Video"

config GST1_LIBAV_MUXER_mpeg2video
	bool "MPEG-2 Video"

config GST1_LIBAV_MUXER_mpegts
	bool "MPEG-2 (TS)"

config GST1_LIBAV_MUXER_ogg
	bool "Ogg"

config GST1_LIBAV_MUXER_oss
	bool "OSS (Open Sound System playback)"

config GST1_LIBAV_MUXER_rtp
	bool "RTP"

comment "Demuxers ---"

config GST1_LIBAV_DEMUXER_ac3
	bool "AC3"

config GST1_LIBAV_DEMUXER_ffm
	bool "FFM (ffserver live feed)"

config GST1_LIBAV_DEMUXER_h264
	bool "H.264"
	depends on GST1_LIBAV_PATENTED

config GST1_LIBAV_DEMUXER_mp3
	bool "MP3 (MPEG Audio Layer 3)"

config GST1_LIBAV_DEMUXER_mpegvideo
	bool "MPEG Video"

config GST1_LIBAV_DEMUXER_mpegps
	bool "MPEG-2 (PS)"

config GST1_LIBAV_DEMUXER_mpegts
	bool "MPEG-2 (TS)"

config GST1_LIBAV_DEMUXER_ogg
	bool "Ogg"

config GST1_LIBAV_DEMUXER_rm
	bool "RM"
	help
	  RealMedia format demuxer

config GST1_LIBAV_DEMUXER_rtsp
	bool "RTSP"
	select GST1_LIBAV_DEMUXER_rm
	select GST1_LIBAV_DEMUXER_sdp

config GST1_LIBAV_DEMUXER_sdp
	bool "SDP"
	select GST1_LIBAV_DEMUXER_mpegts

comment "Parsers ---"

config GST1_LIBAV_PARSER_aac
	bool "AAC (Advanced Audio Coding)"
	depends on GST1_LIBAV_PATENTED

config GST1_LIBAV_PARSER_ac3
	bool "AC3"

config GST1_LIBAV_PARSER_cook
	bool "Cook / Cooker / Gecko (RealAudio G2)"
	depends on GST1_LIBAV_PATENTED

config GST1_LIBAV_PARSER_h264
	bool "H.264"
	depends on GST1_LIBAV_PATENTED
	select GST1_LIBAV_DECODER_h264

config GST1_LIBAV_PARSER_mpegaudio
	bool "MPEG Audio"

config GST1_LIBAV_PARSER_mpegvideo
	bool "MPEG Video"

config GST1_LIBAV_PARSER_mpeg4video
	bool "MPEG-4 Video"

comment "Protocols ---"

config GST1_LIBAV_PROTOCOL_file
	bool "file:"

config GST1_LIBAV_PROTOCOL_http
	bool "http:"

config GST1_LIBAV_PROTOCOL_pipe
	bool "pipe:"

config GST1_LIBAV_PROTOCOL_rtp
	bool "rtp:"
	select GST1_LIBAV_PROTOCOL_udp

config GST1_LIBAV_PROTOCOL_tcp
	bool "tcp:"

config GST1_LIBAV_PROTOCOL_udp
	bool "udp:"

endmenu
```
