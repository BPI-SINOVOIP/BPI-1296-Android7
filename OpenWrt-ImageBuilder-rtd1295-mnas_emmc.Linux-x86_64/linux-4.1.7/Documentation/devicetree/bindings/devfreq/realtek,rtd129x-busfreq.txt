## OpenWrt-ImageBuilder-rtd1295-mnas_emmc.Linux-x86_64/toolchain/Config.in
```kconfig
# Copyright (C) 2006-2013 OpenWrt.org
#
# This is free software, licensed under the GNU General Public License v2.
# See /LICENSE for more information.
#

menuconfig TARGET_OPTIONS
	bool "Target Options"  if DEVEL

	config TARGET_OPTIMIZATION
		string "Target Optimizations" if TARGET_OPTIONS
		default DEFAULT_TARGET_OPTIMIZATION
		help
		  Optimizations to use when building for the target host.

	config SOFT_FLOAT
		bool "Use software floating point by default" if TARGET_OPTIONS
		default y if !HAS_FPU
		depends on arm || armeb || powerpc || mipsel || mips || mips64el || mips64
		help
		  If your target CPU does not have a Floating Point Unit (FPU) or a
		  kernel FPU emulator, but you still wish to support floating point
		  functions, then everything will need to be compiled with soft floating
		  point support (-msoft-float).

		  Most people will answer N.

	config USE_MIPS16
		bool "Build packages with MIPS16 instructions" if TARGET_OPTIONS
		depends on HAS_MIPS16
		depends on !GCC_VERSION_4_6
		default y
		help
		  If your target CPU does support the MIPS16 instruction set
		  and you want to use it for packages, enable this option.
		  MIPS16 produces smaller binaries thus reducing pressure on
		  caches and TLB.

		  Most people will answer N.


menuconfig EXTERNAL_TOOLCHAIN
	bool
	prompt "Use external toolchain"  if DEVEL
	help
	  If enabled, OpenWrt will compile using an existing toolchain instead of
	  compiling one.

	config NATIVE_TOOLCHAIN
		bool
		prompt "Use host's toolchain"  if DEVEL
		depends on EXTERNAL_TOOLCHAIN
		select NO_STRIP
		help
		  If enabled, OpenWrt will compile using the native toolchain for your
		  host instead of compiling one.

	config TARGET_NAME
		string
		prompt "Target name"  if DEVEL
		depends on EXTERNAL_TOOLCHAIN && !NATIVE_TOOLCHAIN
		default "aarch64-unknown-linux-gnu"  if aarch64
		default "aarch64_be-unknown-linux-gnu"  if aarch64_be
		default "arm-unknown-linux-gnu"      if arm
		default "armeb-unknown-linux-gnu"    if armeb
		default "i486-unknown-linux-gnu"     if i386
		default "mips-unknown-linux-gnu"     if mips
		default "mipsel-unknown-linux-gnu"   if mipsel
		default "powerpc-unknown-linux-gnu"  if powerpc
		default "x86_64-unknown-linux-gnu"   if x86_64

	config TOOLCHAIN_PREFIX
		string
		prompt "Toolchain prefix"  if DEVEL
		depends on EXTERNAL_TOOLCHAIN && !NATIVE_TOOLCHAIN
		default "aarch64-unknown-linux-gnu"  if aarch64
		default "aarch64_be-unknown-linux-gnu"  if aarch64_be
		default "arm-unknown-linux-gnu-"      if arm
		default "armeb-unknown-linux-gnu-"    if armeb
		default "i486-unknown-linux-gnu-"     if i386
		default "mips-unknown-linux-gnu-"     if mips
		default "mipsel-unknown-linux-gnu-"   if mipsel
		default "powerpc-unknown-linux-gnu-"  if powerpc
		default "x86_64-unknown-linux-gnu-"   if x86_64

	config TOOLCHAIN_ROOT
		string
		prompt "Toolchain root"  if DEVEL
		depends on EXTERNAL_TOOLCHAIN && !NATIVE_TOOLCHAIN
		default "/opt/cross/aarch64-unknown-linux-gnu"  if aarch64
		default "/opt/cross/aarch64_be-unknown-linux-gnu"  if aarch64_be
		default "/opt/cross/arm-unknown-linux-gnu"      if arm
		default "/opt/cross/armeb-unknown-linux-gnu"    if armeb
		default "/opt/cross/i486-unknown-linux-gnu"     if i386
		default "/opt/cross/mips-unknown-linux-gnu"     if mips
		default "/opt/cross/mipsel-unknown-linux-gnu"   if mipsel
		default "/opt/cross/powerpc-unknown-linux-gnu"  if powerpc
		default "/opt/cross/x86_64-unknown-linux-gnu"   if x86_64

	config TOOLCHAIN_LIBC
		string
		prompt "Toolchain libc"  if DEVEL
		depends on EXTERNAL_TOOLCHAIN && !NATIVE_TOOLCHAIN
		default "uclibc"
		help
		  Specify the libc type used by the external toolchain. The given value
		  is passed as -m flag to all gcc and g++ invocations. This is mainly
		  intended for multilib toolchains which support glibc and uclibc at
		  the same time. If no value is specified, no -m flag is passed.

	config TOOLCHAIN_BIN_PATH
		string
		prompt "Toolchain program path"  if DEVEL
		depends on EXTERNAL_TOOLCHAIN && !NATIVE_TOOLCHAIN
		default "./usr/bin ./bin"
		help
		  Specify additional directories searched for toolchain binaries
		  (override PATH). Use ./DIR for directories relative to the root above.

	config TOOLCHAIN_INC_PATH
		string
		prompt "Toolchain include path"  if DEVEL
		depends on EXTERNAL_TOOLCHAIN && !NATIVE_TOOLCHAIN
		default "./usr/include ./include"
		help
		  Specify additional directories searched for header files (override
		  CPPFLAGS). Use ./DIR for directories relative to the root above.

	config TOOLCHAIN_LIB_PATH
		string
		prompt "Toolchain library path"  if DEVEL
		depends on EXTERNAL_TOOLCHAIN && !NATIVE_TOOLCHAIN
		default "./usr/lib ./lib"
		help
		  Specify additional directories searched for libraries (override LDFLAGS).
		  Use ./DIR for directories relative to the root above.

config NEED_TOOLCHAIN
	bool
	depends on DEVEL
	default y if !EXTERNAL_TOOLCHAIN

menuconfig TOOLCHAINOPTS
	bool "Toolchain Options"  if DEVEL
	depends on NEED_TOOLCHAIN

comment "Compiler"
	depends on TOOLCHAINOPTS

source "toolchain/gcc/Config.in"

comment "C Library"
	depends on TOOLCHAINOPTS

choice
	prompt "C Library implementation" if TOOLCHAINOPTS
	default LIBC_USE_GLIBC if (aarch64 || aarch64_be)
	default LIBC_USE_UCLIBC
	help
	  Select the C library implementation.

	config LIBC_USE_GLIBC
		bool "Use (e)glibc"
		select USE_GLIBC

	config LIBC_USE_UCLIBC
		select USE_UCLIBC
		bool "Use uClibc"
		depends on !(aarch64 || aarch64_be)

	config LIBC_USE_MUSL
		select USE_MUSL
		bool "Use musl"
		depends on BROKEN
		depends on !(mips64 || mips64el)

endchoice

source "toolchain/glibc/Config.in"
source "toolchain/uClibc/Config.in"
source "toolchain/musl/Config.in"

comment "Debuggers"
	depends on TOOLCHAINOPTS

config GDB
	bool
	depends on !(aarch64 || aarch64_be)
	prompt "Build gdb" if TOOLCHAINOPTS
	default y if !EXTERNAL_TOOLCHAIN
	help
	  Enable if you want to build the gdb.

config INSIGHT
	bool
	prompt "Build insight-gdb" if TOOLCHAINOPTS
	select GDB
	default n
	help
	  Enable if you want to build insight-gdb.

config USE_GLIBC
	bool
	default y if !TOOLCHAINOPTS && !EXTERNAL_TOOLCHAIN && !NATIVE_TOOLCHAIN && (aarch64 || aarch64_be || octeon)

config USE_UCLIBC
	bool
	default y if !TOOLCHAINOPTS && !EXTERNAL_TOOLCHAIN && !NATIVE_TOOLCHAIN && !(aarch64 || aarch64_be || octeon)

config USE_MUSL
	bool

config USE_EXTERNAL_LIBC
	bool
	default y if EXTERNAL_TOOLCHAIN || NATIVE_TOOLCHAIN

source "toolchain/gcc/Config.version"

source "toolchain/glibc/Config.version"
source "toolchain/uClibc/Config.version"
source "toolchain/musl/Config.version"

config LIBC
	string
	default "glibc"   if USE_GLIBC
	default "uClibc"  if USE_UCLIBC
	default "musl"	  if USE_MUSL

config LIBC_VERSION
	string
	default GLIBC_VERSION   if USE_GLIBC
	default UCLIBC_VERSION  if USE_UCLIBC
	default MUSL_VERSION	if USE_MUSL

config TARGET_SUFFIX
	string
	default "gnueabi"         if USE_GLIBC && (arm || armeb)
	default "gnu"             if USE_GLIBC && !(arm || armeb)
	default "uclibcgnueabi"   if USE_UCLIBC && (arm || armeb)
	default "uclibc"          if USE_UCLIBC && !(arm || armeb)
	default "muslgnueabi"     if USE_MUSL && (arm || armeb)
	default "musl"            if USE_MUSL && !(arm || armeb)
```

## Openwrt/linux-4.1.7/Documentation/devicetree/bindings/clock/realtek,rtd129x-clocks.txt
```
Realtek RTD-129X Clock Controller
=================================

--------------
Clock Provider
--------------

Required properties :
- compatible : shall contain only one of the following:

	"realtek,clock-controller" for Clock Controller 
	"realtek,clock-gate-controller" for Clock Gate Controller

- #clock-cells : shall contain 1

Must contain one of the following properties:

- reg : iomem address required

- realtek,mmio : referring to a regmap for iomem


Properties for Clock Gate Controller :

- realtek,cgc,id : only required by realtek,clock-gate-controller
	The IDs are defined in 'dt-bindings/clock/rtk,cc-rtd129x.h'
	with a prefix 'CGC_'.


Example:

	cc: clock-controlller@98000000 {
		compatible   = "realtek,clock-controller";
		reg = <0x98000000 0x600>;
		#clock-cells = <1>;
		realtek,mmio = <&crt_mmio 0x0>;
	};

	ce1: clk-en@9800000c {
		compatible   = "realtek,clock-gate-controller";
		reg = <0x9800000c 0x4>;
		#clock-cells = <1>;
		realtek,cgc,id = <0>;
		realtek,mmio = <&crt_mmio 0xc>;
	};

--------------
Clock consumer
--------------
The clock id for clock-controller is defined in 
'dt-bindings/clock/rtk,cc-rtd129x.h' with a prefix 'CC_'. The clock id 
for clock-gate-controller is the bit index of register.

Example:

	device {
		clocks = <&cc CC_PLL_SCPU>, <&ce1 23>;
	};
```

## Openwrt/linux-4.1.7/Documentation/devicetree/bindings/regulator/g2227-regulator.txt
```
GMT G2227 Regulator Driver
==========================

The deivce node should be placed in a i2c_master node. The dt-bindings value 
is defined in 'dt-bindings/regulator/gmt,g2227.h'.

Required properties :
- compatible : shall contain only "gmt-g2227"

- reg : shall contain slave address

Optional properties :
- system-power-controller : use g2227 power-off function as pm_power_off

- g2227,lpoff-act : the action when long press to powerkey. shall contain 
	only the following,
		G2227_LPOFF_TO_SHUTDOWN: long press to shutdown,
		G2227_LPOFF_TO_RESTART: long press to restart.
	
- g2227,lpoff-time : time of long press. shall contain only the following,
	G2227_TIME_LPOFF_06S,
	G2227_TIME_LPOFF_07S,
	G2227_TIME_LPOFF_08S,
	G2227_TIME_LPOFF_10S.

Regulator node
--------------
Required properties:
- regulator-name: shall contain only the followings,
	dcdc1, dcdc2, dcdc3, dcdc4, dcdc5, dcdc6, ldo2, ldo3.

- regulator-state-coldboot node : config regulator state should be in 
	suspend-to-coldboot(S5). The common properties are the same as 
	ones in regulator-state-mem node. if this node is not exist, 
	regulator-state-mem node will be used to config.

Please see 'regulator.txt' to get information of other properties.

Example:
	i2c_0 {
		gmt-g2227@12 {
			compatible = "gmt-g2227";
			reg = <0x12>;
			g2227,lpoff-act = <G2227_LPOFF_TO_SHUTDOWN>;
			g2227,lpoff-time = <G2227_TIME_LPOFF_08S>;

			dcdc2 {
				regulator-name = "dcdc2";
				regulator-min-microvolt = <800000>;
				regulator-max-microvolt = <1187500>;
				regulator-boot-on;
				regulator-always-on;
				regulator-initial-mode = <0>;
				regulator-state-mem {
					regulator-off-in-suspend;
				};
				regulator-state-coldboot {
					regulator-off-in-suspend;
				};
			};
		};
	};
```

## Openwrt/linux-4.1.7/Documentation/devicetree/bindings/regulator/sy8089a-regulator.txt
```
Silergy Sy8089A DT-bindings
===========================

Required properties:
- compatible : shall contain the following
	"silergy,sy8089a".

- pwm : shall contain a phandle to pwm

* Subnode :

Required properties:
- regulator-compatible : shall contain the following
	"pwm-reg-0".

The rest of peropeties in subnode using of-regulator to configure, see 
also 'Documentation/devicetree/bindings/regulator/regulator.txt' for more
information.

Example :
	pwm_regulator {
		compatible = "silergy,sy8089a";
                pwms = <&pwm 2 75>;
                status = "okay";

                cpu_supp: pwm_reg {
                        regulator-compatible = "pwm-reg-0";
                        regulator-name = "pwm-reg-0";
                        regulator-min-microvolt = <800000>;
                        regulator-max-microvolt = <1100000>;

                        regulator-boot-on;
                        regulator-always-on;
                };
        };
```

## Openwrt/linux-4.1.7/Documentation/devicetree/bindings/soc/realtek/sb2-sem.txt
```
Reaktek SB2 Semaphore
=====================

Required properties:

- compatible : shall contain only the following:
        "realtek,sb2-sem".

- reg : hall contain he semaphore address


Example: 
	sb2_lock0: sb2-lock@9801A000 {
		compatible = "realtek,sb2-sem";
		reg = <0x9801A000 0x4>;
	};
```

## Openwrt/linux-4.1.7/Documentation/devicetree/bindings/soc/realtek/uio_devices.txt
```
Realtek UIO devices dt-bindings
===============================

Required properties :

* reg : shall contain to address for a uio device

* compatible : shall contain the followings :
	"realtek,rbus" for RBUS,
	"realtek,refclk" for REFCLK,
	"realtek,md" for MD,
	"realtek,se" for SE,
	"realtek,tp" for TP.

Optional properties :

* clocks : shall contain the relative clock(s).

* resets : shall contain the relative reset(s).

* interrupts : shall contain the relative interrupt(s).
```

## Openwrt/linux-4.1.7/drivers/gator/Kconfig
```kconfig
choice
	prompt "gator version"
	default GATOR_V522
	help
	  gator version selection.

config GATOR_V522
	bool "gator version v5.22"
	help
	  gator version v5.22.

config GATOR_V524
	bool "gator version v5.24"
	help
	  gator version v5.24.

config GATOR_V525
	bool "gator version v5.25"
	help
	  gator version v5.25.

endchoice

if GATOR_V522
source "drivers/gator/gator-v5.22/Kconfig"
endif

if GATOR_V524
source "drivers/gator/gator-v5.24/Kconfig"
endif

if GATOR_V525
source "drivers/gator/gator-v5.25/Kconfig"
endif
```

## Openwrt/linux-4.1.7/drivers/media/platform/rtk_cec/Kconfig
```kconfig
#Copyright (C) 2007-2013 Realtek Semiconductor Corporation.
# drivers/Kconfig

config CEC
	bool "CEC Support"
	
config CEC_CHARDEV
	bool "CEC device interface"
	depends on CEC
	help
	  Say Y here to use cec-* device files, usually found in the /dev/cec/
	  directory on your system.  They make it possible to have user-space
	  programs use the CEC bus.

	  This support is also available as a module.  If so, the module 
	  will be called cec-dev.
	

config CEC_DEBUG
	bool "CEC Debug Mode"
	depends on CEC
	default n
	help 
	  If you want to enable cec debug message, say Y.

menu "CEC Adapters"
	depends on CEC

config RTD1295_CEC
	tristate "CEC Controller for Realtek RTD1295 platform"
	depends on CEC 
	default y
	help
	  Say Y, if you want to enable CEC feature on Realtek RTD1195 platform.

endmenu
```

## Openwrt/linux-4.1.7/drivers/media/platform/rtk_hdmitx/Kconfig
```kconfig
#Copyright (C) 2007-2013 Realtek Semiconductor Corporation.
# drivers/Kconfig

config RTK_HDMITX
	tristate "HDMITX for Realtek RTD1295 platform"
	select I2C
	select SWITCH
    select RTK_RPC
	default n
	help
	  Say Y, if you want to enable HDMITX feature on Realtek RTD1295 platform.

config HDMITX_DBG
	tristate "HDMITX debug sysfs"
	select RTK_HDMITX
	default n
```
